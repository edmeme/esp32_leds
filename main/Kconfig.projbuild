## main/Kconfig.projbuild
```kconfig
menu "Project-specific Configuration"

config BUTTON_GPIO
    int "Rotary Encoder push button GPIO number"
	range 0 39
	default 15
	help
		GPIO number (IOxx) from which to sample the Rotary Encoder button output.

		Some GPIOs are used for other purposes (flash connections, etc.) and cannot be used.

config ROT_ENC_A_GPIO
    int "Rotary Encoder A output GPIO number"
	range 0 39
	default 5
	help
		GPIO number (IOxx) from which to sample the Rotary Encoder 'A' output.

		Some GPIOs are used for other purposes (flash connections, etc.) and cannot be used.

config ROT_ENC_B_GPIO
    int "Rotary Encoder B output GPIO number"
	range 0 39
	default 18
	help
		GPIO number (IOxx) from which to sample the Rotary Encoder 'B' output.

		Some GPIOs are used for other purposes (flash connections, etc.) and cannot be used.


config RGB_RED
    int "RGB pwm red pin"
	range 0 39
	default 21
	help
		RGB pin for red.

config RGB_GREEN
    int "RGB pwm green pin"
	range 0 39
	default 17
	help
		RGB pin for green.

config RGB_BLUE
    int "RGB pwm blue pin"
	range 0 39
	default 2
	help
		RGB pin for blue.


    config WIFI_SSID
        string "WiFi SSID"
        default "Nopeland"
        help
            SSID (network name) for the example to connect to.

    config WIFI_PASSWORD
        string "WiFi Password"
        default "2**3ans8"
        help
            WiFi password (WPA or WPA2) for the example to use.

    config WIFI_MAXIMUM_RETRY
        int "Maximum retry"
        default 5
        help
            Set the Maximum retry to avoid station reconnecting to the AP unlimited when the AP is really inexistent.

    config HOSTNAME
        string "Host name"
        default "leds"
        help
            Hostname

endmenu
```
